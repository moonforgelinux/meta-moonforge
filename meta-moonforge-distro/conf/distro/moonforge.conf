## meta-moonforge-distro/conf/distro/moonforge.conf
```bitbake
#
# SPDX-License-Identifier: MIT
# SPDX-FileCopyrightText: 2025 Igalia S.L.
#

DISTRO = "moonforge"
DISTRO_NAME = "Moonforge (Moonforge Linux Distribution)"
DISTRO_VERSION = "2.0"
DISTRO_CODENAME = "main"
SDK_VENDOR = "-moonforgesdk"
SDK_VERSION = "${@d.getVar('DISTRO_VERSION').replace('snapshot-${METADATA_REVISION}', 'snapshot')}"
SDK_VERSION[vardepvalue] = "${SDK_VERSION}"

MAINTAINER = "The Moonforge team <info@moonforgelinux.org>"

TARGET_VENDOR = "-moonforge"

LOCALCONF_VERSION = "2"

# Override these in moonforge based distros
MOONFORGE_DEFAULT_DISTRO_FEATURES = ""
MOONFORGE_DEFAULT_EXTRA_RDEPENDS = "packagegroup-core-boot"
MOONFORGE_DEFAULT_EXTRA_RRECOMMENDS = "kernel-module-af-packet"

DISTRO_FEATURES ?= "${MOONFORGE_DEFAULT_DISTRO_FEATURES}"

PREFERRED_VERSION_linux-yocto ?= "6.18%"
PREFERRED_VERSION_linux-yocto-rt ?= "6.18%"

SDK_NAME = "${DISTRO}-${TCLIBC}-${SDKMACHINE}-${IMAGE_BASENAME}-${TUNE_PKGARCH}-${MACHINE}"
SDKPATHINSTALL = "/opt/${DISTRO}/${SDK_VERSION}"

DISTRO_EXTRA_RDEPENDS += "${MOONFORGE_DEFAULT_EXTRA_RDEPENDS}"
DISTRO_EXTRA_RRECOMMENDS += "${MOONFORGE_DEFAULT_EXTRA_RRECOMMENDS}"

PACKAGE_CLASSES ?= "package_rpm"

SANITY_TESTED_DISTROS ?= " \
            debian-13 \n \
            "

BB_SIGNATURE_HANDLER ?= "OEEquivHash"
BB_HASHSERVE ??= "auto"

MOONFORGE_INIT_MANAGER = "systemd"
INIT_MANAGER ?= "${MOONFORGE_INIT_MANAGER}"

# We need debug symbols so that SPDX license manifests for the kernel work
KERNEL_EXTRA_FEATURES:append = " features/debug/debug-kernel.scc"
```

## meta-moonforge-distro/conf/layer.conf
```bitbake
#
# SPDX-License-Identifier: MIT
# SPDX-FileCopyrightText: 2025 Igalia S.L.
#

# We have a conf and classes directory, add to BBPATH
BBPATH .= ":${LAYERDIR}"

# We have recipes-* directories, add to BBFILES
BBFILES += "${LAYERDIR}/recipes-*/*/*.bb \
            ${LAYERDIR}/recipes-*/*/*.bbappend"

BBFILE_COLLECTIONS += "meta-moonforge-distro"
BBFILE_PATTERN_meta-moonforge-distro = "^${LAYERDIR}/"
BBFILE_PRIORITY_meta-moonforge-distro = "6"

LAYERDEPENDS_meta-moonforge-distro = "core"
LAYERSERIES_COMPAT_meta-moonforge-distro = "wrynose"
```

## meta-moonforge-docker/conf/layer.conf
```bitbake
# We have a conf and classes directory, add to BBPATH
BBPATH .= ":${LAYERDIR}"

# We have recipes-* directories, add to BBFILES
BBFILES += "${LAYERDIR}/recipes-*/*/*.bb \
            ${LAYERDIR}/recipes-*/*/*.bbappend"

BBFILE_COLLECTIONS += "meta-moonforge-docker"
BBFILE_PATTERN_meta-moonforge-docker = "^${LAYERDIR}/"
BBFILE_PRIORITY_meta-moonforge-docker = "9"

LAYERDEPENDS_meta-moonforge-docker = " \
    core \
    virtualization-layer \
"
LAYERSERIES_COMPAT_meta-moonforge-docker = "scarthgap"
```

## meta-moonforge-graphics/conf/layer.conf
```bitbake
# We have a conf and classes directory, add to BBPATH
BBPATH .= ":${LAYERDIR}"

# We have recipes-* directories, add to BBFILES
BBFILES += "${LAYERDIR}/recipes-*/*/*.bb \
            ${LAYERDIR}/recipes-*/*/*.bbappend"

BBFILE_COLLECTIONS += "meta-moonforge-graphics"
BBFILE_PATTERN_meta-moonforge-graphics = "^${LAYERDIR}/"
BBFILE_PRIORITY_meta-moonforge-graphics = "6"

LAYERDEPENDS_meta-moonforge-graphics = "core"
LAYERSERIES_COMPAT_meta-moonforge-graphics = "scarthgap"
```

## meta-moonforge-podman/conf/layer.conf
```bitbake
# We have a conf and classes directory, add to BBPATH
BBPATH .= ":${LAYERDIR}"

# We have recipes-* directories, add to BBFILES
BBFILES += "${LAYERDIR}/recipes-*/*/*.bb \
            ${LAYERDIR}/recipes-*/*/*.bbappend"

BBFILE_COLLECTIONS += "meta-moonforge-podman"
BBFILE_PATTERN_meta-moonforge-podman = "^${LAYERDIR}/"
BBFILE_PRIORITY_meta-moonforge-podman = "9"

LAYERDEPENDS_meta-moonforge-podman = " \
    core \
    virtualization-layer \
"
LAYERSERIES_COMPAT_meta-moonforge-podman = "scarthgap"
```

## meta-moonforge-qemu/conf/layer.conf
```bitbake
# We have a conf and classes directory, add to BBPATH
BBPATH .= ":${LAYERDIR}"

# We have recipes-* directories, add to BBFILES
BBFILES += "${LAYERDIR}/recipes-*/*/*.bb \
            ${LAYERDIR}/recipes-*/*/*.bbappend"

BBFILE_COLLECTIONS += "meta-moonforge-qemu"
BBFILE_PATTERN_meta-moonforge-qemu = "^${LAYERDIR}/"
BBFILE_PRIORITY_meta-moonforge-qemu = "7"

LAYERDEPENDS_meta-moonforge-qemu = "core"
LAYERSERIES_COMPAT_meta-moonforge-qemu = "wrynose"
```

## meta-moonforge-raspberrypi/conf/layer.conf
```bitbake
# We have a conf and classes directory, add to BBPATH
BBPATH .= ":${LAYERDIR}"

# We have recipes-* directories, add to BBFILES
BBFILES += "${LAYERDIR}/recipes-*/*/*.bb \
            ${LAYERDIR}/recipes-*/*/*.bbappend"

BBFILE_COLLECTIONS += "meta-moonforge-raspberrypi"
BBFILE_PATTERN_meta-moonforge-raspberrypi = "^${LAYERDIR}/"
BBFILE_PRIORITY_meta-moonforge-raspberrypi = "10"

LAYERDEPENDS_meta-moonforge-raspberrypi = " \
    core \
    lts-u-boot-mixin \
    raspberrypi \
"
LAYERSERIES_COMPAT_meta-moonforge-raspberrypi = "scarthgap"
```

## meta-moonforge-rauc-update/conf/layer.conf
```bitbake
# We have a conf and classes directory, add to BBPATH
BBPATH .= ":${LAYERDIR}"

# We have recipes-* directories, add to BBFILES
BBFILES += "${LAYERDIR}/recipes-*/*/*.bb \
            ${LAYERDIR}/recipes-*/*/*.bbappend"

BBFILE_COLLECTIONS += "meta-moonforge-rauc-update"
BBFILE_PATTERN_meta-moonforge-rauc-update = "^${LAYERDIR}/"
BBFILE_PRIORITY_meta-moonforge-rauc-update = "6"

LAYERDEPENDS_meta-moonforge-rauc-update = " \
    core \
    meta-moonforge-rauc \
"
LAYERSERIES_COMPAT_meta-moonforge-rauc-update = "scarthgap"
```

## meta-moonforge-rauc/conf/layer.conf
```bitbake
# We have a conf and classes directory, add to BBPATH
BBPATH .= ":${LAYERDIR}"

# We have recipes-* directories, add to BBFILES
BBFILES += "${LAYERDIR}/recipes-*/*/*.bb \
            ${LAYERDIR}/recipes-*/*/*.bbappend"

BBFILES_DYNAMIC += " \
    meta-moonforge-qemu:${LAYERDIR}/dynamic-layers/meta-moonforge-qemu/*/*/*.bb \
    meta-moonforge-qemu:${LAYERDIR}/dynamic-layers/meta-moonforge-qemu/*/*/*.bbappend \
    meta-moonforge-raspberrypi:${LAYERDIR}/dynamic-layers/meta-moonforge-raspberrypi/*/*/*.bb \
    meta-moonforge-raspberrypi:${LAYERDIR}/dynamic-layers/meta-moonforge-raspberrypi/*/*/*.bbappend \
"

BBFILE_COLLECTIONS += "meta-moonforge-rauc"
BBFILE_PATTERN_meta-moonforge-rauc = "^${LAYERDIR}/"
BBFILE_PRIORITY_meta-moonforge-rauc = "7"

LAYERDEPENDS_meta-moonforge-rauc = " \
    core \
    rauc \
"
LAYERRECOMMENDS_meta-moonforge-rauc = " \
    meta-moonforge-qemu \
    meta-moonforge-raspberrypi \
"
LAYERSERIES_COMPAT_meta-moonforge-rauc = "scarthgap"

RAUC_KEY_FILE ?= "${LAYERDIR}/files/meta-moonforge-demo-1.key.pem"
RAUC_CERT_FILE ?= "${LAYERDIR}/files/meta-moonforge-demo-1.cert.pem"
RAUC_KEYRING_FILE ?= "${LAYERDIR}/recipes-core/rauc/files/ca.cert.pem"
```

## meta-moonforge-wpe/conf/layer.conf
```bitbake
# We have a conf and classes directory, add to BBPATH
BBPATH .= ":${LAYERDIR}"

# We have recipes-* directories, add to BBFILES
BBFILES += "${LAYERDIR}/recipes-*/*/*.bb \
            ${LAYERDIR}/recipes-*/*/*.bbappend"

BBFILE_COLLECTIONS += "meta-moonforge-wpe"
BBFILE_PATTERN_meta-moonforge-wpe = "^${LAYERDIR}/"
BBFILE_PRIORITY_meta-moonforge-wpe = "8"

LAYERDEPENDS_meta-moonforge-wpe = " \
    core \
    webkit \
"
LAYERSERIES_COMPAT_meta-moonforge-wpe = "scarthgap"
```
